#include <U8g2lib.h>
#include "SongData.h"

#define GAP_RATIO 5
#define STATE_LOADING 1
#define STATE_MENU 2
#define STATE_GAMING 3
#define STATE_SCORE 4
#define SPEED_CONTROLLER 102.3
#define KEY_A 1
#define KEY_B 2
#define KEY_C 3
#define KEY_D 4
#define SCORE_PERFECT 10
#define SCORE_GOOD 9
#define SCORE_HIT 6
#define SCORE_MISS 0
#define PIN_A 8
#define PIN_B 9
#define PIN_C 10
#define PIN_D 11

// Hardware I2C
U8G2_SSD1306_128X64_NONAME_1_HW_I2C u8g2(U8G2_R0);

static const unsigned char AEEMO_LOGO[] PROGMEM = {
	0x00, 0x00, 0x00, 0x00, 0x00, 0x00, 0x00, 0x00, 0x00, 0x00, 0x00, 0x00,
	0x00, 0x00, 0x00, 0x00, 0x00, 0x00, 0x00, 0x00, 0x00, 0x00, 0x00, 0x00,
	0x00, 0x00, 0x00, 0x00, 0x00, 0x00, 0x00, 0x00, 0x00, 0x00, 0x00, 0x00,
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	0x00, 0x00, 0x00, 0x00, 0x00, 0x00, 0x00, 0x00 };

static const unsigned char RATING_S[] PROGMEM = {
	0x00, 0x00, 0x00, 0x00, 0x00, 0x00, 0x00, 0x00, 0x00, 0x00, 0x00, 0x00,
	0x00, 0x00, 0x00, 0x00, 0x00, 0x00, 0x00, 0x00, 0x00, 0x00, 0x00, 0x00,
	0x00, 0x00, 0x00, 0x00, 0x00, 0x00, 0x00, 0x00, 0xF0, 0xFF, 0x3F, 0x00,
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	0x00, 0x00, 0x00, 0x00, 0x00, 0x00, 0x00, 0x00, 0x00, 0x00, 0x00, 0x00 };

static const unsigned char RATING_A[] PROGMEM = {
	0x00, 0x00, 0x00, 0x00, 0x00, 0x00, 0x00, 0x00, 0x00, 0x00, 0x00, 0x00,
	0x00, 0x00, 0x00, 0x00, 0x00, 0x00, 0x00, 0x00, 0x00, 0x00, 0x00, 0x00,
	0x00, 0x00, 0x00, 0x00, 0x00, 0x00, 0x00, 0x00, 0x00, 0x00, 0x00, 0x00,
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	0x00, 0x00, 0x00, 0x00, 0x00, 0x00, 0x00, 0x00, 0x00, 0x00, 0x00, 0x00 };

static const unsigned char RATING_B[] PROGMEM = {
	0x00, 0x00, 0x00, 0x00, 0x00, 0x00, 0x00, 0x00, 0x00, 0x00, 0x00, 0x00,
	0x00, 0x00, 0x00, 0x00, 0x00, 0x00, 0x00, 0x00, 0x00, 0x00, 0x00, 0x00,
	0x00, 0x00, 0x00, 0x00, 0x00, 0x00, 0x00, 0x00, 0x00, 0x00, 0x00, 0x00,
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	0x00, 0x00, 0x00, 0x00, 0x00, 0x00, 0x00, 0x00, 0x00, 0x00, 0x00, 0x00 };

static const unsigned char RATING_C[] PROGMEM = {
	0x00, 0x00, 0x00, 0x00, 0x00, 0x00, 0x00, 0x00, 0x00, 0x00, 0x00, 0x00,
	0x00, 0x00, 0x00, 0x00, 0x00, 0x00, 0x00, 0x00, 0x00, 0x00, 0x00, 0x00,
	0x00, 0x00, 0x00, 0x00, 0x00, 0x00, 0x00, 0x00, 0x00, 0x00, 0x00, 0x00,
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	0x00, 0x00, 0x00, 0x00, 0x00, 0x00, 0x00, 0x00, 0x00, 0x00, 0x00, 0x00 };

static const unsigned char RATING_D[] PROGMEM =
{ 0x00, 0x00, 0x00, 0x00, 0x00, 0x00, 0x00, 0x00, 0x00, 0x00, 0x00, 0x00,
 0x00, 0x00, 0x00, 0x00, 0x00, 0x00, 0x00, 0x00, 0x00, 0x00, 0x00, 0x00,
 0x00, 0x00, 0x00, 0x00, 0x00, 0x00, 0x00, 0x00, 0x00, 0x00, 0x00, 0x00,
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 0x00, 0x00, 0x00, 0x00, 0x00, 0x00, 0x00, 0x00, 0x00, 0x00, 0x00, 0x00 };

unsigned long clock = 0;
unsigned long clock_start = millis();
unsigned long clock_song_start = 0;

int state;
int selectedSong = 0;
int rawPlayingPos = 0;
int playingPos;
int lastPlayingPos = 0;

int counter_perfect = 0;
int counter_good = 0;
int counter_hit = 0;
int counter_miss = 0;

int total_score = 0;
int user_score = 0;
float rating;

char last_judge[] = "GET READY";

void setup(void) {
	Serial.begin(9600);
	u8g2.begin(/*Select=*/PIN_D, /*Right/Next=*/PIN_B, /*Left/Prev=*/PIN_A,
		/*Up=*/PIN_A,
		/*Down=*/PIN_B, /*Home/Cancel=*/PIN_C);
}

void drawLogo(int CopyrightPos) {
	// u8g2.setFont(u8g2_font_ncenB14_tr);
	u8g2.drawXBMP(0, 0, 128, 32, AEEMO_LOGO);
	u8g2.setFont(u8g2_font_5x8_tr);
	u8g2.drawHLine(8, 36, 108);
	u8g2.drawStr(9, 50, "A Microduino Music Game");
	u8g2.drawStr(20 + CopyrightPos, 60, "By Bill Chen, V0.1");
}

bool ifRefreshed() { return (playingPos != lastPlayingPos ? 1 : 0); }

void drawNote(int key, int distance) {
	int offset;
	switch (key) {
	case KEY_A:
		offset = 26;
		break;
	case KEY_B:
		offset = 51;
		break;
	case KEY_C:
		offset = 76;
		break;
	case KEY_D:
		offset = 101;
	}
	u8g2.drawBox(offset, 55 - distance, 3, 3);
}

void drawKeyPressed(int key) {
	int offset;
	switch (key) {
	case KEY_A:
		offset = 2;
		break;
	case KEY_B:
		offset = 27;
		break;
	case KEY_C:
		offset = 52;
		break;
	case KEY_D:
		offset = 77;
	}
	u8g2.drawTriangle(25 + offset - 3, 63, 25 + offset + 3, 63, 25 + offset, 58);
}

int key2pin(int key) {
	int pin;
	switch (key) {
	case KEY_A:
		pin = PIN_A;
		break;
	case KEY_B:
		pin = PIN_B;
		break;
	case KEY_C:
		pin = PIN_C;
		break;
	case KEY_D:
		pin = PIN_D;
		break;
	}
	return pin;
}

void judgeFromKey(int key) {
	int pin = key2pin(key);
	for (int i = 0; i <= 6; i++) {
		if (pgm_read_byte(SCOREDATA[selectedSong - 1][key - 1] + playingPos - i) ==
			1) {
			return;
		}
	}
	// Serial.print("A");
	if (pgm_read_byte(SCOREDATA[selectedSong - 1][key - 1] + playingPos) == 0) {
		int shortestDis = 0;
		for (int i = 0; i < 15; i++) {
			shortestDis++;
			if (pgm_read_byte(SCOREDATA[selectedSong - 1][key - 1] + playingPos +
				i) == 1) {
				break;
			}
		}
		if (shortestDis <= 1) {

		}
		else if (shortestDis <= 3) {
			counter_good++;
			user_score += SCORE_GOOD;
			counter_perfect--;
			user_score -= SCORE_PERFECT;
			strcpy(last_judge, "GOOD");
		}
		else if (shortestDis <= 7) {
			counter_hit++;
			user_score += SCORE_HIT;
			counter_perfect--;
			user_score -= SCORE_PERFECT;
			strcpy(last_judge, "HIT");
		}
		else {
			counter_miss++;
			user_score += SCORE_MISS;
			counter_perfect--;
			user_score -= SCORE_PERFECT;
			strcpy(last_judge, "MISS");
		}
	}
}

void judgeFromSong(int key) {
	int pin = key2pin(key);
	if (!digitalRead(pin)) {
		counter_perfect++;
		user_score += SCORE_PERFECT;
		strcpy(last_judge, "PERFECT");
	}
	else {
		counter_miss++;
		user_score += SCORE_MISS;
		strcpy(last_judge, "MISS");
	}
}

// char* calScore(){

// 	float rating = (float(user_score) / float(total_score)) * 100;
// 	static char* buffer;
// 	sprintf(buffer, "%.2f%%", rating);
// 	return buffer;
// }

void drawGamePad() {
	u8g2.setFont(u8g2_font_profont10_tr);
	u8g2.drawDisc(4, 4, 3, U8G2_DRAW_ALL);
	u8g2.drawStr(10, 8, last_judge);
	//　Indicate the progress of the song
	u8g2.drawHLine(
		0, 10,
		int((float(playingPos) / float(SONGLENGTH[selectedSong - 1])) * 128));
	if (playingPos == SONGLENGTH[selectedSong - 1]) {
		state = STATE_SCORE;
		selectedSong = 0;
	}
	u8g2.drawHLine(0, 11, 128);
	rating = (float(user_score) / float(total_score)) * 100;
	int n1 = int(rating), n2 = int(rating * 100) % 100;
	char rateText[10];
	sprintf(rateText, "RATE:%2d.%02d%%", n1, n2);
	u8g2.drawStr(73, 8, rateText);
	u8g2.drawHLine(0, 60, 128);
	u8g2.drawHLine(0, 64, 128);
	for (int i = 0; i < 12; i++) {
		if (pgm_read_byte(SCOREDATA[selectedSong - 1][0] + playingPos + i) == 1) {
			drawNote(KEY_A, i * 4);
			if (ifRefreshed() && i == 0) {
				judgeFromSong(KEY_A);
			}
		}
		if (pgm_read_byte(SCOREDATA[selectedSong - 1][1] + playingPos + i) == 1) {
			drawNote(KEY_B, i * 4);
			if (ifRefreshed() && i == 0) {
				judgeFromSong(KEY_B);
			}
		}
		if (pgm_read_byte(SCOREDATA[selectedSong - 1][2] + playingPos + i) == 1) {
			drawNote(KEY_C, i * 4);
			if (ifRefreshed() && i == 0) {
				judgeFromSong(KEY_C);
			}
		}
		if (pgm_read_byte(SCOREDATA[selectedSong - 1][3] + playingPos + i) == 1) {
			drawNote(KEY_D, i * 4);
			if (ifRefreshed() && i == 0) {
				judgeFromSong(KEY_D);
			}
		}
		// if (SCOREDATA_1_A[playingPos + i] == 1) {
		//   drawNote(KEY_A, i * 3);
		// }
		// if (SCOREDATA_1_B[playingPos + i] == 1) {
		//   drawNote(KEY_B, i * 3);
		// }
		// if (SCOREDATA_1_C[playingPos + i] == 1) {
		//   drawNote(KEY_C, i * 3);
		// }
		// if (SCOREDATA_1_D[playingPos + i] == 1) {
		//   drawNote(KEY_D, i * 3);
		// }
	}
	lastPlayingPos = playingPos;
	if(user_score < 0){
		user_score = 0;
	}
	if(user_score > total_score){
		user_score = total_score;
	}
}

void reset(){
	clock_start = millis();
	clock = 0;
	counter_good = 0;
	counter_hit = 0;
	counter_miss = 0;
	counter_perfect = 0;
	selectedSong = 0;
	total_score = 0;
	user_score = 0;
	rating = 0;
	rawPlayingPos = 0;
	playingPos = 0;
	lastPlayingPos = 0;
	
}

void drawRating() {
	u8g2.setFont(u8g2_font_5x8_tr);
	if (rating >= 85) {
		u8g2.drawXBMP(6, 12, 48, 48, RATING_S);
	}
	else if (rating >= 75) {
		u8g2.drawXBMP(6, 12, 48, 48, RATING_A);
	}
	else if (rating >= 60) {
		u8g2.drawXBMP(6, 12, 48, 48, RATING_B);
	}
	else if (rating >= 30) {
		u8g2.drawXBMP(6, 12, 48, 48, RATING_C);
	}
	else {
		u8g2.drawXBMP(6, 12, 48, 48, RATING_D);
	}
	u8g2.setFont(u8g2_font_profont11_tr);
	char temp[16];
	sprintf(temp, "RATE:%2d.%02d%%", int(rating), int(rating * 100) % 100);
	u8g2.drawStr(60, 12, temp);
	u8g2.drawHLine(56, 16, 80);
	u8g2.drawHLine(56, 17, 80);
	sprintf(temp, "PERFECT:%d", counter_perfect);
	u8g2.drawStr(60, 30, temp);
	sprintf(temp, "GOOD:%d", counter_good);
	u8g2.drawStr(60, 40, temp);
	sprintf(temp, "HIT:%d", counter_hit);
	u8g2.drawStr(60, 50, temp);
	sprintf(temp, "MISS:%d", counter_miss);
	u8g2.drawStr(60, 60, temp);
	if(!digitalRead(PIN_A) || !digitalRead(PIN_B) || !digitalRead(PIN_C) || !digitalRead(PIN_D)){
		state = STATE_MENU;
		u8g2.clear();
		reset();
	}
}

void draw() {
	int selection;
	switch (state) {
	case STATE_LOADING:
		drawLogo(clock / 200);
		break;
	case STATE_MENU:
		u8g2.setFont(u8g2_font_profont11_tr);
		selection = u8g2.userInterfaceSelectionList(
			"Select Song", 1, "1. Arknights\n2. Wings of Piano\n3. Without Me");
		if (selection == 0) {
			clock_start = millis();
		}
		else {
			selectedSong = selection;
		}
		break;
	case STATE_GAMING:
		drawGamePad();
		// u8g2.setFont(u8g2_font_sticker_mel_tr);
		// u8g2.drawStr(12, 12 , "STARTED!");
		playingPos = (millis() - clock_song_start) / SPEED_CONTROLLER;
		if (!digitalRead(PIN_A)) {
			drawKeyPressed(KEY_A);
			if (ifRefreshed()) {
				judgeFromKey(KEY_A);
			}
		}
		if (!digitalRead(PIN_B)) {
			drawKeyPressed(KEY_B);
			if (ifRefreshed()) {
				judgeFromKey(KEY_B);
			}
		}
		if (!digitalRead(PIN_C)) {
			drawKeyPressed(KEY_C);
			if (ifRefreshed()) {
				judgeFromKey(KEY_C);
			}
		}
		if (!digitalRead(PIN_D)) {
			drawKeyPressed(KEY_D);
			if (ifRefreshed()) {
				judgeFromKey(KEY_D);
			}
		}
		rawPlayingPos++;
		// playingPos = rawPlayingPos / GAP_RATIO;

		break;
	case STATE_SCORE:
		drawRating();
		break;
	}
}

void calTotalScore() {
	for (int i = 0; i < SONGLENGTH[selectedSong - 1]; i++) {
		if (pgm_read_byte(SCOREDATA[selectedSong - 1][0] + i) == 1) {
			total_score += SCORE_PERFECT;
		}
		if (pgm_read_byte(SCOREDATA[selectedSong - 1][1] + i) == 1) {
			total_score += SCORE_PERFECT;
		}
		if (pgm_read_byte(SCOREDATA[selectedSong - 1][2] + i) == 1) {
			total_score += SCORE_PERFECT;
		}
		if (pgm_read_byte(SCOREDATA[selectedSong - 1][3] + i) == 1) {
			total_score += SCORE_PERFECT;
		}
	}
}

void stateShifter() {
	if (clock <= 3 * 1000) {
		state = STATE_LOADING;
	}
	else if (state == STATE_SCORE) {}
	else if (state != STATE_GAMING) {
		state = STATE_MENU;
	}
	if (selectedSong != 0 && state != STATE_GAMING) {
		char msg[16];
		sprintf(msg, "You selected no.%d.", selectedSong);
		int sel = u8g2.userInterfaceMessage("Loading...", msg, "Confirm?",
			" OK \n Cancel ");
		if (sel == 0 || sel == 2) {
			selectedSong = 0;
		}
		else {
			state = STATE_GAMING;
			playingPos = 0;
			rawPlayingPos = 0;
			calTotalScore();
			//Serial.println(total_score);
			clock_song_start = millis();
			u8g2.clear();
			// Serial.println("Game Started");
		}
	}
}

void loop(void) {
	// Serial.println(sizeof(SCOREDATA_1)/4/sizeof(bool));
	clock = millis() - clock_start;
	// Serial.println(clock);
	u8g2.firstPage();
	do {
		stateShifter();
		//state = STATE_SCORE;
		draw();
	} while (u8g2.nextPage());
	delay(10);
}